/* USER CODE BEGIN Header */
/**
  ******************************************************************************
  * @file           : main.c
  * @brief          : Main program body
  ******************************************************************************
  * @attention
  *
  * Copyright (c) 2026 STMicroelectronics.
  * All rights reserved.
  *
  * This software is licensed under terms that can be found in the LICENSE file
  * in the root directory of this software component.
  * If no LICENSE file comes with this software, it is provided AS-IS.
  *
  ******************************************************************************
  */
/* USER CODE END Header */
/* Includes ------------------------------------------------------------------*/
#include "main.h"
#include "cmsis_os.h"
#include "fatfs.h"

/* Private includes ----------------------------------------------------------*/
/* USER CODE BEGIN Includes */
/* TEAM CODE (integration: Brendon): headers of the team modules */
/* main.c is generated by STM32CubeMX from the .ioc. The team's code is only
 * in the USER CODE blocks, which CubeMX keeps when it regenerates the file.
 * What main() does at power-on, in order:
 *   1. HAL_Init, the HSE clock probe (USER CODE Init) and SystemClock_Config:
 *      a 72 MHz CPU clock made by the PLL from the 8 MHz HSE clock.
 *   2. MX_*_Init: every peripheral as set in the .ioc (pins, DMA, interrupts).
 *   3. USER CODE 2: each member's X_Init() (hardware and module state only:
 *      no queue exists yet).
 *   4. osKernelInitialize, then App_RTOS_Init (USER CODE RTOS_QUEUES): every
 *      queue, pool and semaphore of app_rtos.h, and the sixth task,
 *      FxRenderTask.
 *   5. The five generated osThreadNew calls: one per CubeMX task. Each runs
 *      its Start*Task function at the bottom of this file.
 *   6. osKernelStart: the FreeRTOS scheduler takes over and never returns.
 * The HAL callbacks in USER CODE 0 are where interrupts hand work to tasks
 * (HAL = ST's hardware driver library, the HAL_* functions).
 * The serial console (USART2, LogTask, the boot banner and the solo builds)
 * was removed on 1 Nov 2026; faults show on the TFT fault screen. */
#include "app_rtos.h"
#include "tony_ports.h"
#include "brendon_battery_usb.h"
#include "brendon_ports.h"
#include "jack_audio_sd.h"
#include "tom_dac_output.h"
#include "tony_ui.h"
/* USER CODE END Includes */

/* Private typedef -----------------------------------------------------------*/
/* USER CODE BEGIN PTD */

/* USER CODE END PTD */

/* Private define ------------------------------------------------------------*/
/* USER CODE BEGIN PD */

/* USER CODE END PD */

/* Private macro -------------------------------------------------------------*/
/* USER CODE BEGIN PM */

/* USER CODE END PM */

/* Private variables ---------------------------------------------------------*/
ADC_HandleTypeDef hadc1;

CRC_HandleTypeDef hcrc;

I2C_HandleTypeDef hi2c1;

I2S_HandleTypeDef hi2s2;
I2S_HandleTypeDef hi2s3;
DMA_HandleTypeDef hdma_spi2_rx;
DMA_HandleTypeDef hdma_spi3_tx;

SD_HandleTypeDef hsd;
DMA_HandleTypeDef hdma_sdio_rx;
DMA_HandleTypeDef hdma_sdio_tx;

SPI_HandleTypeDef hspi1;

TIM_HandleTypeDef htim3;

/* Definitions for JackAudioTask */
osThreadId_t JackAudioTaskHandle;
const osThreadAttr_t JackAudioTask_attributes = {
  .name = "JackAudioTask",
  .stack_size = 768 * 4,
  .priority = (osPriority_t) osPriorityHigh,
};
/* Definitions for TomTask */
osThreadId_t TomTaskHandle;
const osThreadAttr_t TomTask_attributes = {
  .name = "TomTask",
  .stack_size = 1024 * 4,
  .priority = (osPriority_t) osPriorityAboveNormal,
};
/* Definitions for JackStorageTask */
osThreadId_t JackStorageTaskHandle;
const osThreadAttr_t JackStorageTask_attributes = {
  .name = "JackStorageTask",
  .stack_size = 1024 * 4,
  .priority = (osPriority_t) osPriorityNormal,
};
/* Definitions for BrendonTask */
osThreadId_t BrendonTaskHandle;
const osThreadAttr_t BrendonTask_attributes = {
  .name = "BrendonTask",
  .stack_size = 768 * 4,
  .priority = (osPriority_t) osPriorityBelowNormal,
};
/* Definitions for TonyTask */
osThreadId_t TonyTaskHandle;
const osThreadAttr_t TonyTask_attributes = {
  .name = "TonyTask",
  .stack_size = 768 * 4,
  .priority = (osPriority_t) osPriorityLow,
};
/* USER CODE BEGIN PV */

/* USER CODE END PV */

/* Private function prototypes -----------------------------------------------*/
void SystemClock_Config(void);
void PeriphCommonClock_Config(void);
static void MX_GPIO_Init(void);
static void MX_DMA_Init(void);
static void MX_ADC1_Init(void);
static void MX_CRC_Init(void);
static void MX_I2C1_Init(void);
static void MX_I2S2_Init(void);
static void MX_I2S3_Init(void);
static void MX_SDIO_SD_Init(void);
static void MX_SPI1_Init(void);
static void MX_TIM3_Init(void);
void StartJackAudioTask(void *argument);
void StartTomTask(void *argument);
void StartJackStorageTask(void *argument);
void StartBrendonTask(void *argument);
void StartTonyTask(void *argument);

/* USER CODE BEGIN PFP */
/* TEAM CODE (integration: Brendon): prototype for the HSE probe */
static void clock_probe_hse(void);
/* USER CODE END PFP */

/* Private user code ---------------------------------------------------------*/
/* USER CODE BEGIN 0 */
/* TEAM CODE (integration: Brendon): HSE clock probe and the HAL callbacks (callback owners marked below) */

/* ---- HSE source probe -------------------------------------------------------
 * HSE = the high-speed external clock input (pins OSC_IN / OSC_OUT); the PLL
 * turns its 8 MHz into the 72 MHz CPU clock (SystemClock_Config).
 * The .ioc is set up for the PCB: HSE = 8 MHz crystal (RCC_HSE_ON in
 * SystemClock_Config). The Nucleo-F411RE the team also tests on has no crystal
 * fitted; its 8 MHz comes from the ST-LINK MCO into OSC_IN, which needs BYPASS.
 * Rather than keeping two builds, probe before SystemClock_Config() runs:
 *   1) BYPASS (amplifier off, OSC_IN driven externally). This is the
 *      configuration every board test so far ran on. A passive crystal cannot
 *      produce a clock with the amplifier off, so on the PCB HSERDY stays 0.
 *   2) otherwise crystal mode (HSEBYP cleared).
 * Bypass is tried first because the reverse order is ambiguous: an MCO-driven
 * OSC_IN can also satisfy the crystal-mode amplifier. HAL_RCC_OscConfig() with
 * RCC_HSE_ON only sets HSEON and leaves HSEBYP as the probe left it, so the
 * generated code then brings the PLL up from whichever source started. Costs
 * at most HSE_STARTUP_TIMEOUT (100 ms) once, on the crystal board. */
static uint8_t hse_ready_within(uint32_t timeout_ms)
{
    uint32_t t0 = HAL_GetTick();
    while (READ_BIT(RCC->CR, RCC_CR_HSERDY) == 0U)
    {
        if ((HAL_GetTick() - t0) > timeout_ms)
        {
            return 0U;
        }
    }
    return 1U;
}

static void clock_probe_hse(void)
{
    /* 1) external clock on OSC_IN (Nucleo ST-LINK MCO) */
    CLEAR_BIT(RCC->CR, RCC_CR_HSEON);
    SET_BIT(RCC->CR, RCC_CR_HSEBYP);
    SET_BIT(RCC->CR, RCC_CR_HSEON);
    if (hse_ready_within(HSE_STARTUP_TIMEOUT))
    {
        return;   /* Nucleo: leave bypass mode set for SystemClock_Config() */
    }

    /* 2) crystal (PCB). HSEBYP may only change while HSE is off. */
    CLEAR_BIT(RCC->CR, RCC_CR_HSEON);
    while (READ_BIT(RCC->CR, RCC_CR_HSERDY) != 0U) { }
    CLEAR_BIT(RCC->CR, RCC_CR_HSEBYP);
    SET_BIT(RCC->CR, RCC_CR_HSEON);
    (void)hse_ready_within(HSE_STARTUP_TIMEOUT);   /* SystemClock_Config() re-checks; Error_Handler() if neither */
}

/* ---- HAL callbacks (ISR context). Rule: only flags, timeout-0 queue puts,
 * semaphore releases and pointer bookkeeping happen here — no text
 * formatting, no memcpy of audio (lecture 07). All IRQs that reach these run
 * at NVIC priority >= 5 (configLIBRARY_MAX_SYSCALL_INTERRUPT_PRIORITY). ---- */
/* ISR = interrupt service routine: the code the CPU runs when an interrupt
 * fires. The path is always the same: the peripheral's IRQ handler
 * (stm32f4xx_it.c) calls the HAL, the HAL calls one of the callbacks below,
 * and the callback sets a thread flag on the task that owns the peripheral.
 * That task wakes up in osThreadFlagsWait and does the real work at its own
 * priority. Why the callbacks do so little:
 *   - an ISR is not a task and can never wait, so a queue put from an ISR
 *     must use timeout 0 (the CMSIS-RTOS layer refuses any other timeout
 *     there); a full queue drops the item and counts it (slide 18);
 *   - while an ISR runs, every task and every less urgent interrupt waits,
 *     so it must be short: no text formatting (slow, and it needs a lot of
 *     stack) and no copying of audio;
 *   - handing over costs nothing: if the woken task outranks the one that
 *     was interrupted, FreeRTOS switches to it as soon as the ISR ends.
 * Why priority 5 or more: in the NVIC (the Cortex-M4's interrupt controller)
 * a LOWER number is MORE urgent (0..15 here). Inside its critical sections
 * FreeRTOS masks only priorities 5..15 (configMAX_SYSCALL_INTERRUPT_PRIORITY
 * in FreeRTOSConfig.h: the same 5, shifted into the NVIC register format),
 * so only those interrupts may call the FreeRTOS "FromISR" functions behind
 * osThreadFlagsSet and osMessageQueuePut. An interrupt at 0..4 could cut
 * into the kernel half-way through a change to its task lists and corrupt
 * them. Here (.ioc): the four DMA streams and SDIO at 5; OTG_FS (USB) at 6;
 * TIM5 (the HAL tick) and FreeRTOS's own SysTick and PendSV at 15.
 * Slide numbers in this file refer to ZEIT4230 lecture 07. "PD6" below is
 * the team's Prototype Design 6 stage, in which each member's code was moved
 * into its own FreeRTOS task (notes in the docs/pr folder). */

/* TEAM CODE (owner: Brendon): I2C1 fuel-gauge callbacks for BrendonTask */
/* I2C1 (BrendonTask owns it): memory-read/write complete or error -> flags.
 * Only reachable once CubeMX enables the I2C1 event + error interrupts
 * (see docs/pr/PD6-Brendon.md); until then the bus port uses the blocking
 * fallback and these callbacks are never entered. */
/* They would run in the I2C1 event / error interrupts (I2C1_EV_IRQn,
 * I2C1_ER_IRQn) and set BRENDON_I2C_DONE_FLAG or BRENDON_I2C_ERR_FLAG on
 * BrendonTask (brendon_ports.c), which waits for one of them per transfer. */
void HAL_I2C_MemRxCpltCallback(I2C_HandleTypeDef *hi2c)
{
    if (hi2c->Instance == I2C1) BrendonPorts_I2cDoneISR();
}
void HAL_I2C_MemTxCpltCallback(I2C_HandleTypeDef *hi2c)
{
    if (hi2c->Instance == I2C1) BrendonPorts_I2cDoneISR();
}
void HAL_I2C_ErrorCallback(I2C_HandleTypeDef *hi2c)
{
    if (hi2c->Instance == I2C1) BrendonPorts_I2cErrorISR();
}

/* TEAM CODE (owner: Tony): SPI1 and ADC1 callbacks for TonyTask (written by Brendon in the PD6 port) */
/* SPI1 / ADC1 (TonyTask owns both): transfer / conversion complete -> flags.
 * Only reachable once CubeMX enables the SPI1 and ADC global interrupts
 * (docs/pr/PD6-Tony.md); until then tony_ports.c uses the blocking fallback
 * and these callbacks are never entered. */
/* They would run in SPI1_IRQn / ADC_IRQn and set TONY_SPI_DONE_FLAG or
 * TONY_ADC_DONE_FLAG on TonyTask, which waits for it per transfer. */
void HAL_SPI_TxCpltCallback(SPI_HandleTypeDef *hspi)
{
    if (hspi->Instance == SPI1) TonyPorts_SpiDoneISR();
}
void HAL_ADC_ConvCpltCallback(ADC_HandleTypeDef *hadc)
{
    if (hadc->Instance == ADC1) TonyPorts_AdcDoneISR();
}

/* TEAM CODE (owner: Jack): I2S2 microphone DMA callbacks for JackAudioTask (written by Brendon in the PD6 port) */
/* I2S2 RX DMA (JackAudioTask owns it): half/full -> thread flags. The task
 * treats both bits pending at once as a missed deadline (slide 9). */
/* Both run in DMA1_Stream3_IRQHandler (priority 5) through HAL_DMA_IRQHandler.
 * I2S is a serial audio bus; here I2S2 clocks the PDM microphone (PB10 clock,
 * PB15 data). PDM = pulse density modulation: the mic sends a 1-bit stream,
 * which JackAudioTask's PDM2PCM filter turns into normal 16-bit samples
 * (PCM). DMA = direct memory access: hardware that copies the bits into
 * s_pdm_buffer (jack_audio_sd.c) without the CPU, round and round (circular):
 *   half-transfer     -> JACK_AUDIO_HALF_FLAG: the first half is full;
 *   transfer-complete -> JACK_AUDIO_FULL_FLAG: the second half is full.
 * Each half is about 1 ms of microphone bits (32 PCM samples). The task
 * converts the full half while the DMA fills the other one.
 * Where 1 ms and 32 come from: I2S2 is set to 64 kHz with 32-bit frames, so
 * the mic gets a clock of about 2 MHz and sends that many bits a second. A
 * half holds 128 x 16 = 2048 bits (about 1 ms); the filter keeps one sample
 * per 64 bits (decimation by 64), so 32 samples: audio at 32 kHz. */
void HAL_I2S_RxHalfCpltCallback(I2S_HandleTypeDef *hi2s)
{
    if (hi2s->Instance == SPI2 && JackAudioTaskHandle != NULL) {
        (void)osThreadFlagsSet(JackAudioTaskHandle, JACK_AUDIO_HALF_FLAG);
    }
}
void HAL_I2S_RxCpltCallback(I2S_HandleTypeDef *hi2s)
{
    if (hi2s->Instance == SPI2 && JackAudioTaskHandle != NULL) {
        (void)osThreadFlagsSet(JackAudioTaskHandle, JACK_AUDIO_FULL_FLAG);
    }
}

/* TEAM CODE (owner: Tom): I2S3 speaker DMA callbacks for TomTask (written by Brendon in the PD6 port) */
/* I2S3 TX DMA (TomTask owns it): circular double buffer, half/full -> flags
 * telling Tom which half was just released for refilling. */
/* Both run in DMA1_Stream5_IRQHandler (priority 5) through HAL_DMA_IRQHandler.
 * The circular DMA sends s_tx_buffer (tom_dac_output.c) round and round to
 * the DAC (digital-to-analogue converter: the I2S chip that drives the
 * speakers); each half is 4 ms of sound (192 stereo frames at 48 kHz; the
 * .ioc shows that the I2S clock divider really gives 47.62 kHz, 0.8 % slow):
 *   half-transfer     -> TOM_DAC_HALF_FLAG: the first half has been sent and
 *                        the DMA now plays the second, so refill the first;
 *   transfer-complete -> TOM_DAC_FULL_FLAG: the second half has been sent and
 *                        the DMA is back at the first, so refill the second.
 * TomTask has 4 ms to refill a half before the DMA reaches it again. */
void HAL_I2S_TxHalfCpltCallback(I2S_HandleTypeDef *hi2s)
{
    if (hi2s->Instance == SPI3 && TomTaskHandle != NULL) {
        (void)osThreadFlagsSet(TomTaskHandle, TOM_DAC_HALF_FLAG);
    }
}
void HAL_I2S_TxCpltCallback(I2S_HandleTypeDef *hi2s)
{
    if (hi2s->Instance == SPI3 && TomTaskHandle != NULL) {
        (void)osThreadFlagsSet(TomTaskHandle, TOM_DAC_FULL_FLAG);
    }
}

/* USER CODE END 0 */

/**
  * @brief  The application entry point.
  * @retval int
  */
int main(void)
{

  /* USER CODE BEGIN 1 */

  /* USER CODE END 1 */

  /* MCU Configuration--------------------------------------------------------*/

  /* Reset of all peripherals, Initializes the Flash interface and the Systick. */
  HAL_Init();

  /* USER CODE BEGIN Init */
  /* TEAM CODE (integration: Brendon): run the HSE probe before SystemClock_Config() */
  /* It must come first: SystemClock_Config() only switches the HSE on and
   * starts the PLL from it; crystal or bypass mode (the HSEBYP bit) is
   * whatever this probe has left set for the board it found. */
  clock_probe_hse();   /* PCB crystal, or Nucleo MCO bypass — see USER CODE 0 */
  /* USER CODE END Init */

  /* Configure the system clock */
  SystemClock_Config();

  /* Configure the peripherals common clocks */
  PeriphCommonClock_Config();

  /* USER CODE BEGIN SysInit */

  /* USER CODE END SysInit */

  /* Initialize all configured peripherals */
  MX_GPIO_Init();
  MX_DMA_Init();
  MX_ADC1_Init();
  MX_CRC_Init();
  MX_I2C1_Init();
  MX_I2S2_Init();
  MX_I2S3_Init();
  MX_SDIO_SD_Init();
  MX_SPI1_Init();
  MX_FATFS_Init();
  MX_TIM3_Init();
  /* USER CODE BEGIN 2 */
  /* TEAM CODE (integration: Brendon): board notes (comments), then the start-up code below (owners marked) */

  /* Pull-ups: PB2 (REC button) is generated with GPIO_PULLUP in
   * MX_GPIO_Init() above; the SDIO D0-D3/CMD pull-ups live in the generated
   * HAL_SD_MspInit() (all from the .ioc). The old hand-written block here was
   * overwritten for the SDIO lines anyway: HAL_SD_Init() re-runs
   * HAL_SD_MspInit(), which used to set GPIO_NOPULL.
   * PA1 (SD_DETECT, pull-up from the .ioc) is an active-LOW switch: measured
   * 24 Sep 2026, 0 V with a card and 3.3 V without. LOW = card present
   * (Core/Src/sd_detect_override.c, jack_audio_sd.c, brendon_ports.c). */

  /* ===== SDIO (USB-MSC / recording SD card, shared by Brendon and Jack) =====
   * SDIO = the MCU's SD-card interface (a clock, a command line, data D0-D3).
   * FatFs = the FAT file-system library that Jack's recorder uses (f_mount,
   * f_open, ...); USB-MSC = USB Mass Storage, the card shown to a PC as a drive.
   * Everything the card needs is now in the generated code + the .ioc:
   *   - flow control OFF (STM32F4 SDIO errata: HW flow control glitches
   *     SDIO_CK and produces CRC errors);
   *   - ClockDiv 4 -> 8 MHz transfer clock (48 MHz / (4 + 2)), on the 4-bit
   *     bus when the bring-up's read test passes, else 1-bit (HAL_SD_Init
   *     identifies the card at 400 kHz by itself, so a slow Init.ClockDiv is
   *     NOT needed for a reliable f_mount — the old "ClockDiv 118" patch here
   *     left the card at 400 kHz for every transfer afterwards);
   *   - DMA2 stream 3/6 + SDIO_IRQn (stm32f4xx_hal_msp.c / stm32f4xx_it.c),
   *     which the FatFs disk layer Core/Src/sd_diskio_rtos.c needs: it reads
   *     and writes through BSP_SD_ReadBlocks_DMA / BSP_SD_WriteBlocks_DMA. (The
   *     CubeMX DMA template FATFS/Target/sd_diskio.c is no longer compiled.)
   * Do NOT call HAL_SD_Init here — BSP_SD_Init (Core/Src/sd_detect_override.c,
   * reached through f_mount from JackStorageTask) does that. */

  /* TEAM CODE (owner: Tom): switch the I2S3 speaker DMA to circular mode (May 2026) */
  /* -------------------------------------------------------------------
   * 3) I2S3 DAC DMA was generated as DMA_CIRCULAR for
   *    continuous audio playback — otherwise HAL_I2S_Transmit_DMA plays the buffer once (8 ms now) and stops,
   *    leaving the 3 I2S lines (CK, WS, SD) all silent.
   * ------------------------------------------------------------------ */
  /* The .ioc now generates DMA_CIRCULAR itself (HAL_I2S_MspInit in
   * stm32f4xx_hal_msp.c), so the re-init below only repeats that setting and
   * stays as a safety net. TomTask starts this DMA once and never stops it,
   * so circular mode is what keeps the speakers fed. */
  HAL_DMA_DeInit(&hdma_spi3_tx);
  hdma_spi3_tx.Init.Mode = DMA_CIRCULAR;
  /* The result is not checked: this only repeats what the generated init
   * already did, and a failure here used to be only logged. If it ever
   * failed, TomTask could not start the speaker DMA and would show the
   * "Speaker DMA failed" fault. */
  (void)HAL_DMA_Init(&hdma_spi3_tx);
  __HAL_LINKDMA(&hi2s3, hdmatx, hdma_spi3_tx);

  /* TEAM CODE (integration: Brendon): each member's X_Init() call (Tony added the TIM3 handle to Tony_Init) */
  /* Pre-kernel X_Init() calls: hardware + module state only, NO RTOS objects
   * (those are created in App_RTOS_Init() below and first touched inside each
   * X_TaskEntry()). Tony first so the splash shows during the slower inits. */
  /* Waiting is fine here (HAL_Delay in the TFT reset and the gauge probe):
   * no task runs yet, so nothing else can be held up. */
  Tony_Init(&hspi1, &hadc1, &htim3);
  /* Brendon_Init probes the I2C1 fuel gauge. The USB device stack is started
   * later by BrendonTask, only while VBUS_SENSE (PA9) is high. */
  Brendon_Init(&hi2c1);
  /* Jack_Init also sets up the storage status JackStorageTask works with. */
  Jack_Init(&hi2s2);   /* PDM2PCM filter config; the DMA is started by JackAudioTask on command */
  Tom_Init(&hi2s3);    /* zero the double buffer; the circular DMA is started once by TomTask */

  /* Next, in the generated code below: osKernelInitialize(), App_RTOS_Init()
   * (USER CODE RTOS_QUEUES), the five osThreadNew() calls and osKernelStart().
   * No task runs before osKernelStart(); then the highest-priority task that
   * is ready runs first. */
  /* USER CODE END 2 */

  /* Init scheduler */
  osKernelInitialize();

  /* USER CODE BEGIN RTOS_MUTEX */
  /* add mutexes, ... */
  /* USER CODE END RTOS_MUTEX */

  /* USER CODE BEGIN RTOS_SEMAPHORES */
  /* add semaphores, ... */
  /* USER CODE END RTOS_SEMAPHORES */

  /* USER CODE BEGIN RTOS_TIMERS */
  /* start timers, add new ones, ... */
  /* USER CODE END RTOS_TIMERS */

  /* USER CODE BEGIN RTOS_QUEUES */
  /* TEAM CODE (integration: Brendon): create every shared queue, pool and semaphore */
  /* Every shared queue / pool / semaphore of the firmware (app_rtos.h) is
   * created here, after the kernel is initialised and before any task exists. */
  /* Why exactly here: CMSIS-RTOS v2 needs osKernelInitialize() (above) before
   * any object is created, and with every object made before the first task,
   * each task can use its queues from its very first line. App_RTOS_Init()
   * also creates the sixth task, FxRenderTask (CubeMX does not know it).
   * The five osThreadNew() calls below are generated from the .ioc, which
   * fixes each task's priority and stack (task map: app_rtos.h). The two
   * audio tasks, whose DMA halves come every 1 ms and 4 ms, get the highest
   * priorities: JackAudioTask High, TomTask AboveNormal. */
  App_RTOS_Init();
  /* USER CODE END RTOS_QUEUES */

  /* Create the thread(s) */
  /* creation of JackAudioTask */
  JackAudioTaskHandle = osThreadNew(StartJackAudioTask, NULL, &JackAudioTask_attributes);

  /* creation of TomTask */
  TomTaskHandle = osThreadNew(StartTomTask, NULL, &TomTask_attributes);

  /* creation of JackStorageTask */
  JackStorageTaskHandle = osThreadNew(StartJackStorageTask, NULL, &JackStorageTask_attributes);

  /* creation of BrendonTask */
  BrendonTaskHandle = osThreadNew(StartBrendonTask, NULL, &BrendonTask_attributes);

  /* creation of TonyTask */
  TonyTaskHandle = osThreadNew(StartTonyTask, NULL, &TonyTask_attributes);

  /* USER CODE BEGIN RTOS_THREADS */
  /* add threads, ... */
  /* USER CODE END RTOS_THREADS */

  /* USER CODE BEGIN RTOS_EVENTS */
  /* add events, ... */
  /* USER CODE END RTOS_EVENTS */

  /* Start scheduler */
  osKernelStart();

  /* We should never get here as control is now taken by the scheduler */

  /* Infinite loop */
  /* USER CODE BEGIN WHILE */
  /* TEAM CODE (integration: Brendon): comment only - the super-loop is never reached */
  while (1)
  {
    /* Never reached: osKernelStart() above hands control to the scheduler.
     * The former cooperative super-loop (Jack/Tom/Tony/Brendon _Task()) is
     * now the five FreeRTOS tasks below — see docs/RTOS_ARCHITECTURE.md.
     * (A sixth, FxRenderTask, is newer work and starts in App_RTOS_Init.) */

    /* USER CODE END WHILE */

    /* USER CODE BEGIN 3 */
  }
  /* USER CODE END 3 */
}

/**
  * @brief System Clock Configuration
  * @retval None
  */
void SystemClock_Config(void)
{
  RCC_OscInitTypeDef RCC_OscInitStruct = {0};
  RCC_ClkInitTypeDef RCC_ClkInitStruct = {0};

  /** Configure the main internal regulator output voltage
  */
  __HAL_RCC_PWR_CLK_ENABLE();
  __HAL_PWR_VOLTAGESCALING_CONFIG(PWR_REGULATOR_VOLTAGE_SCALE1);

  /** Initializes the RCC Oscillators according to the specified parameters
  * in the RCC_OscInitTypeDef structure.
  */
  RCC_OscInitStruct.OscillatorType = RCC_OSCILLATORTYPE_HSE;
  RCC_OscInitStruct.HSEState = RCC_HSE_ON;
  RCC_OscInitStruct.PLL.PLLState = RCC_PLL_ON;
  RCC_OscInitStruct.PLL.PLLSource = RCC_PLLSOURCE_HSE;
  RCC_OscInitStruct.PLL.PLLM = 4;
  RCC_OscInitStruct.PLL.PLLN = 72;
  RCC_OscInitStruct.PLL.PLLP = RCC_PLLP_DIV2;
  RCC_OscInitStruct.PLL.PLLQ = 3;
  if (HAL_RCC_OscConfig(&RCC_OscInitStruct) != HAL_OK)
  {
    Error_Handler();
  }

  /** Initializes the CPU, AHB and APB buses clocks
  */
  RCC_ClkInitStruct.ClockType = RCC_CLOCKTYPE_HCLK|RCC_CLOCKTYPE_SYSCLK
                              |RCC_CLOCKTYPE_PCLK1|RCC_CLOCKTYPE_PCLK2;
  RCC_ClkInitStruct.SYSCLKSource = RCC_SYSCLKSOURCE_PLLCLK;
  RCC_ClkInitStruct.AHBCLKDivider = RCC_SYSCLK_DIV1;
  RCC_ClkInitStruct.APB1CLKDivider = RCC_HCLK_DIV2;
  RCC_ClkInitStruct.APB2CLKDivider = RCC_HCLK_DIV1;

  if (HAL_RCC_ClockConfig(&RCC_ClkInitStruct, FLASH_LATENCY_2) != HAL_OK)
  {
    Error_Handler();
  }
}

/**
  * @brief Peripherals Common Clock Configuration
  * @retval None
  */
void PeriphCommonClock_Config(void)
{
  RCC_PeriphCLKInitTypeDef PeriphClkInitStruct = {0};

  /** Initializes the peripherals clock
  */
  PeriphClkInitStruct.PeriphClockSelection = RCC_PERIPHCLK_I2S;
  PeriphClkInitStruct.PLLI2S.PLLI2SN = 192;
  PeriphClkInitStruct.PLLI2S.PLLI2SM = 4;
  PeriphClkInitStruct.PLLI2S.PLLI2SR = 4;
  if (HAL_RCCEx_PeriphCLKConfig(&PeriphClkInitStruct) != HAL_OK)
  {
    Error_Handler();
  }
}

/**
  * @brief ADC1 Initialization Function
  * @param None
  * @retval None
  */
static void MX_ADC1_Init(void)
{

  /* USER CODE BEGIN ADC1_Init 0 */

  /* USER CODE END ADC1_Init 0 */

  ADC_ChannelConfTypeDef sConfig = {0};

  /* USER CODE BEGIN ADC1_Init 1 */

  /* USER CODE END ADC1_Init 1 */

  /** Configure the global features of the ADC (Clock, Resolution, Data Alignment and number of conversion)
  */
  hadc1.Instance = ADC1;
  hadc1.Init.ClockPrescaler = ADC_CLOCK_SYNC_PCLK_DIV2;
  hadc1.Init.Resolution = ADC_RESOLUTION_12B;
  hadc1.Init.ScanConvMode = DISABLE;
  hadc1.Init.ContinuousConvMode = DISABLE;
  hadc1.Init.DiscontinuousConvMode = DISABLE;
  hadc1.Init.ExternalTrigConvEdge = ADC_EXTERNALTRIGCONVEDGE_NONE;
  hadc1.Init.ExternalTrigConv = ADC_SOFTWARE_START;
  hadc1.Init.DataAlign = ADC_DATAALIGN_RIGHT;
  hadc1.Init.NbrOfConversion = 1;
  hadc1.Init.DMAContinuousRequests = DISABLE;
  hadc1.Init.EOCSelection = ADC_EOC_SINGLE_CONV;
  if (HAL_ADC_Init(&hadc1) != HAL_OK)
  {
    Error_Handler();
  }

  /** Configure for the selected ADC regular channel its corresponding rank in the sequencer and its sample time.
  */
  sConfig.Channel = ADC_CHANNEL_10;
  sConfig.Rank = 1;
  sConfig.SamplingTime = ADC_SAMPLETIME_3CYCLES;
  if (HAL_ADC_ConfigChannel(&hadc1, &sConfig) != HAL_OK)
  {
    Error_Handler();
  }
  /* USER CODE BEGIN ADC1_Init 2 */

  /* USER CODE END ADC1_Init 2 */

}

/**
  * @brief CRC Initialization Function
  * @param None
  * @retval None
  */
static void MX_CRC_Init(void)
{

  /* USER CODE BEGIN CRC_Init 0 */

  /* USER CODE END CRC_Init 0 */

  /* USER CODE BEGIN CRC_Init 1 */

  /* USER CODE END CRC_Init 1 */
  hcrc.Instance = CRC;
  if (HAL_CRC_Init(&hcrc) != HAL_OK)
  {
    Error_Handler();
  }
  /* USER CODE BEGIN CRC_Init 2 */

  /* USER CODE END CRC_Init 2 */

}

/**
  * @brief I2C1 Initialization Function
  * @param None
  * @retval None
  */
static void MX_I2C1_Init(void)
{

  /* USER CODE BEGIN I2C1_Init 0 */

  /* USER CODE END I2C1_Init 0 */

  /* USER CODE BEGIN I2C1_Init 1 */

  /* USER CODE END I2C1_Init 1 */
  hi2c1.Instance = I2C1;
  hi2c1.Init.ClockSpeed = 100000;
  hi2c1.Init.DutyCycle = I2C_DUTYCYCLE_2;
  hi2c1.Init.OwnAddress1 = 0;
  hi2c1.Init.AddressingMode = I2C_ADDRESSINGMODE_7BIT;
  hi2c1.Init.DualAddressMode = I2C_DUALADDRESS_DISABLE;
  hi2c1.Init.OwnAddress2 = 0;
  hi2c1.Init.GeneralCallMode = I2C_GENERALCALL_DISABLE;
  hi2c1.Init.NoStretchMode = I2C_NOSTRETCH_DISABLE;
  if (HAL_I2C_Init(&hi2c1) != HAL_OK)
  {
    Error_Handler();
  }
  /* USER CODE BEGIN I2C1_Init 2 */
  /* TEAM CODE (owner: Brendon): comment only - fuel-gauge I2C bus notes */
  /* ===== Brendon: fuel-gauge I2C bus =====
   * This is the BQ34Z100-G1 gauge bus (PD2 req 2.1). Standard-mode 100 kHz,
   * 7-bit addressing — the gauge's 7-bit address 0x55 is left-shifted by the
   * driver into the HAL's 8-bit form 0xAA (BQ_ADDR in brendon_ports.c). Polled, no
   * IRQ/DMA. Pins PB6=SCL / PB7=SDA (AF4, open-drain) are set in
   * stm32f4xx_hal_msp.c. The gauge is probed by Brendon_Init() (before the
   * kernel) and read by BrendonTask (Brendon_TaskEntry) in brendon_battery_usb.c.
   * Polled because the .ioc enables no I2C1 interrupt: brendon_ports.c then
   * uses blocking HAL calls (100 ms timeout) inside BrendonTask, and it
   * switches to the _IT calls + thread flags by itself once both I2C1
   * interrupts are enabled.
   * Words: I2C = a two-wire bus (clock SCL, data SDA); the fuel gauge is the
   * chip that measures the battery (voltage, current, state of charge); PD2 =
   * the team's Prototype Design 2 document, which numbers the requirements. */
  /* USER CODE END I2C1_Init 2 */

}

/**
  * @brief I2S2 Initialization Function
  * @param None
  * @retval None
  */
static void MX_I2S2_Init(void)
{

  /* USER CODE BEGIN I2S2_Init 0 */

  /* USER CODE END I2S2_Init 0 */

  /* USER CODE BEGIN I2S2_Init 1 */

  /* USER CODE END I2S2_Init 1 */
  hi2s2.Instance = SPI2;
  hi2s2.Init.Mode = I2S_MODE_MASTER_RX;
  hi2s2.Init.Standard = I2S_STANDARD_PHILIPS;
  hi2s2.Init.DataFormat = I2S_DATAFORMAT_16B;
  hi2s2.Init.MCLKOutput = I2S_MCLKOUTPUT_DISABLE;
  hi2s2.Init.AudioFreq = 64000;
  hi2s2.Init.CPOL = I2S_CPOL_LOW;
  hi2s2.Init.ClockSource = I2S_CLOCK_PLL;
  hi2s2.Init.FullDuplexMode = I2S_FULLDUPLEXMODE_DISABLE;
  if (HAL_I2S_Init(&hi2s2) != HAL_OK)
  {
    Error_Handler();
  }
  /* USER CODE BEGIN I2S2_Init 2 */

  /* USER CODE END I2S2_Init 2 */

}

/**
  * @brief I2S3 Initialization Function
  * @param None
  * @retval None
  */
static void MX_I2S3_Init(void)
{

  /* USER CODE BEGIN I2S3_Init 0 */

  /* USER CODE END I2S3_Init 0 */

  /* USER CODE BEGIN I2S3_Init 1 */

  /* USER CODE END I2S3_Init 1 */
  hi2s3.Instance = SPI3;
  hi2s3.Init.Mode = I2S_MODE_MASTER_TX;
  hi2s3.Init.Standard = I2S_STANDARD_PHILIPS;
  hi2s3.Init.DataFormat = I2S_DATAFORMAT_16B;
  hi2s3.Init.MCLKOutput = I2S_MCLKOUTPUT_DISABLE;
  hi2s3.Init.AudioFreq = I2S_AUDIOFREQ_48K;
  hi2s3.Init.CPOL = I2S_CPOL_LOW;
  hi2s3.Init.ClockSource = I2S_CLOCK_PLL;
  hi2s3.Init.FullDuplexMode = I2S_FULLDUPLEXMODE_DISABLE;
  if (HAL_I2S_Init(&hi2s3) != HAL_OK)
  {
    Error_Handler();
  }
  /* USER CODE BEGIN I2S3_Init 2 */

  /* USER CODE END I2S3_Init 2 */

}

/**
  * @brief SDIO Initialization Function
  * @param None
  * @retval None
  */
static void MX_SDIO_SD_Init(void)
{

  /* USER CODE BEGIN SDIO_Init 0 */

  /* USER CODE END SDIO_Init 0 */

  /* USER CODE BEGIN SDIO_Init 1 */

  /* USER CODE END SDIO_Init 1 */
  hsd.Instance = SDIO;
  hsd.Init.ClockEdge = SDIO_CLOCK_EDGE_RISING;
  hsd.Init.ClockBypass = SDIO_CLOCK_BYPASS_DISABLE;
  hsd.Init.ClockPowerSave = SDIO_CLOCK_POWER_SAVE_DISABLE;
  hsd.Init.BusWide = SDIO_BUS_WIDE_1B;
  hsd.Init.HardwareFlowControl = SDIO_HARDWARE_FLOW_CONTROL_DISABLE;
  hsd.Init.ClockDiv = 4;
  /* USER CODE BEGIN SDIO_Init 2 */
  /* TEAM CODE (integration: Brendon): comment only - how the shared SD card is brought up */
  /* ===== SD backing store: Jack's recorder (FATFS) + Brendon's USB-MSC =====
   * This generated init only POPULATES hsd.Init (1-bit bus, ClockDiv 4 =
   * 8 MHz transfer clock, flow control off); it does NOT call HAL_SD_Init().
   * The card is brought up from thread context: JackStorageTask -> f_mount ->
   * BSP_SD_Init (Core/Src/sd_detect_override.c), and after the "eject-to-use"
   * hand-over by BrendonTask's MSC_Poll() (PD5b_Brendon/Application/msc_store.c,
   * through brendon_ports.c) for USB Mass Storage (PD2 reqs 2.14-2.16). Both
   * use this clock, on the 4-bit bus when BSP_SD_Init's 4-bit read test
   * passed, else on the 1-bit bus (SD_Bus4BitStatus() in sd_bsp_override.h).
   * "Eject-to-use": JackStorageTask unmounts the card (and sets
   * g_msc_media_ready) before the PC may use it, so the card never has two
   * owners at once. */
  /* USER CODE END SDIO_Init 2 */

}

/**
  * @brief SPI1 Initialization Function
  * @param None
  * @retval None
  */
static void MX_SPI1_Init(void)
{

  /* USER CODE BEGIN SPI1_Init 0 */

  /* USER CODE END SPI1_Init 0 */

  /* USER CODE BEGIN SPI1_Init 1 */

  /* USER CODE END SPI1_Init 1 */
  /* SPI1 parameter configuration*/
  hspi1.Instance = SPI1;
  hspi1.Init.Mode = SPI_MODE_MASTER;
  hspi1.Init.Direction = SPI_DIRECTION_2LINES;
  hspi1.Init.DataSize = SPI_DATASIZE_8BIT;
  hspi1.Init.CLKPolarity = SPI_POLARITY_LOW;
  hspi1.Init.CLKPhase = SPI_PHASE_1EDGE;
  hspi1.Init.NSS = SPI_NSS_SOFT;
  hspi1.Init.BaudRatePrescaler = SPI_BAUDRATEPRESCALER_8;
  hspi1.Init.FirstBit = SPI_FIRSTBIT_MSB;
  hspi1.Init.TIMode = SPI_TIMODE_DISABLE;
  hspi1.Init.CRCCalculation = SPI_CRCCALCULATION_DISABLE;
  hspi1.Init.CRCPolynomial = 10;
  if (HAL_SPI_Init(&hspi1) != HAL_OK)
  {
    Error_Handler();
  }
  /* USER CODE BEGIN SPI1_Init 2 */

  /* USER CODE END SPI1_Init 2 */

}

/**
  * @brief TIM3 Initialization Function
  * @param None
  * @retval None
  */
static void MX_TIM3_Init(void)
{

  /* USER CODE BEGIN TIM3_Init 0 */

  /* USER CODE END TIM3_Init 0 */

  TIM_Encoder_InitTypeDef sConfig = {0};
  TIM_MasterConfigTypeDef sMasterConfig = {0};

  /* USER CODE BEGIN TIM3_Init 1 */

  /* USER CODE END TIM3_Init 1 */
  htim3.Instance = TIM3;
  htim3.Init.Prescaler = 0;
  htim3.Init.CounterMode = TIM_COUNTERMODE_UP;
  htim3.Init.Period = 65535;
  htim3.Init.ClockDivision = TIM_CLOCKDIVISION_DIV4;
  htim3.Init.AutoReloadPreload = TIM_AUTORELOAD_PRELOAD_DISABLE;
  sConfig.EncoderMode = TIM_ENCODERMODE_TI12;
  sConfig.IC1Polarity = TIM_ICPOLARITY_RISING;
  sConfig.IC1Selection = TIM_ICSELECTION_DIRECTTI;
  sConfig.IC1Prescaler = TIM_ICPSC_DIV1;
  sConfig.IC1Filter = 15;
  sConfig.IC2Polarity = TIM_ICPOLARITY_RISING;
  sConfig.IC2Selection = TIM_ICSELECTION_DIRECTTI;
  sConfig.IC2Prescaler = TIM_ICPSC_DIV1;
  sConfig.IC2Filter = 15;
  if (HAL_TIM_Encoder_Init(&htim3, &sConfig) != HAL_OK)
  {
    Error_Handler();
  }
  sMasterConfig.MasterOutputTrigger = TIM_TRGO_RESET;
  sMasterConfig.MasterSlaveMode = TIM_MASTERSLAVEMODE_DISABLE;
  if (HAL_TIMEx_MasterConfigSynchronization(&htim3, &sMasterConfig) != HAL_OK)
  {
    Error_Handler();
  }
  /* USER CODE BEGIN TIM3_Init 2 */

  /* USER CODE END TIM3_Init 2 */

}

/**
  * Enable DMA controller clock
  */
static void MX_DMA_Init(void)
{

  /* DMA controller clock enable */
  __HAL_RCC_DMA1_CLK_ENABLE();
  __HAL_RCC_DMA2_CLK_ENABLE();

  /* DMA interrupt init */
  /* DMA1_Stream3_IRQn interrupt configuration */
  HAL_NVIC_SetPriority(DMA1_Stream3_IRQn, 5, 0);
  HAL_NVIC_EnableIRQ(DMA1_Stream3_IRQn);
  /* DMA1_Stream5_IRQn interrupt configuration */
  HAL_NVIC_SetPriority(DMA1_Stream5_IRQn, 5, 0);
  HAL_NVIC_EnableIRQ(DMA1_Stream5_IRQn);
  /* DMA2_Stream3_IRQn interrupt configuration */
  HAL_NVIC_SetPriority(DMA2_Stream3_IRQn, 5, 0);
  HAL_NVIC_EnableIRQ(DMA2_Stream3_IRQn);
  /* DMA2_Stream6_IRQn interrupt configuration */
  HAL_NVIC_SetPriority(DMA2_Stream6_IRQn, 5, 0);
  HAL_NVIC_EnableIRQ(DMA2_Stream6_IRQn);

}

/**
  * @brief GPIO Initialization Function
  * @param None
  * @retval None
  */
static void MX_GPIO_Init(void)
{
  GPIO_InitTypeDef GPIO_InitStruct = {0};
  /* USER CODE BEGIN MX_GPIO_Init_1 */

  /* USER CODE END MX_GPIO_Init_1 */

  /* GPIO Ports Clock Enable */
  __HAL_RCC_GPIOC_CLK_ENABLE();
  __HAL_RCC_GPIOH_CLK_ENABLE();
  __HAL_RCC_GPIOA_CLK_ENABLE();
  __HAL_RCC_GPIOB_CLK_ENABLE();
  __HAL_RCC_GPIOD_CLK_ENABLE();

  /*Configure GPIO pin Output Level */
  HAL_GPIO_WritePin(GPIOC, GPIO_PIN_4|GPIO_PIN_5, GPIO_PIN_RESET);

  /*Configure GPIO pin Output Level */
  HAL_GPIO_WritePin(GPIOB, GPIO_PIN_13|GPIO_PIN_14, GPIO_PIN_RESET);

  /*Configure GPIO pin Output Level */
  HAL_GPIO_WritePin(GPIOA, GPIO_PIN_10, GPIO_PIN_RESET);

  /*Configure GPIO pin : B1_Pin */
  GPIO_InitStruct.Pin = B1_Pin;
  GPIO_InitStruct.Mode = GPIO_MODE_IT_FALLING;
  GPIO_InitStruct.Pull = GPIO_NOPULL;
  HAL_GPIO_Init(B1_GPIO_Port, &GPIO_InitStruct);

  /*Configure GPIO pins : CHG_STAT_Pin SD_DETECT_Pin PA8 */
  GPIO_InitStruct.Pin = CHG_STAT_Pin|SD_DETECT_Pin|GPIO_PIN_8;
  GPIO_InitStruct.Mode = GPIO_MODE_INPUT;
  GPIO_InitStruct.Pull = GPIO_PULLUP;
  HAL_GPIO_Init(GPIOA, &GPIO_InitStruct);

  /*Configure GPIO pins : PC4 PC5 */
  GPIO_InitStruct.Pin = GPIO_PIN_4|GPIO_PIN_5;
  GPIO_InitStruct.Mode = GPIO_MODE_OUTPUT_PP;
  GPIO_InitStruct.Pull = GPIO_NOPULL;
  GPIO_InitStruct.Speed = GPIO_SPEED_FREQ_LOW;
  HAL_GPIO_Init(GPIOC, &GPIO_InitStruct);

  /*Configure GPIO pins : PB0 PB1 PB2 GAUGE_ALERT_Pin
                           CHG_PG_Pin */
  GPIO_InitStruct.Pin = GPIO_PIN_0|GPIO_PIN_1|GPIO_PIN_2|GAUGE_ALERT_Pin
                          |CHG_PG_Pin;
  GPIO_InitStruct.Mode = GPIO_MODE_INPUT;
  GPIO_InitStruct.Pull = GPIO_PULLUP;
  HAL_GPIO_Init(GPIOB, &GPIO_InitStruct);

  /*Configure GPIO pins : PB13 PB14 */
  GPIO_InitStruct.Pin = GPIO_PIN_13|GPIO_PIN_14;
  GPIO_InitStruct.Mode = GPIO_MODE_OUTPUT_PP;
  GPIO_InitStruct.Pull = GPIO_NOPULL;
  GPIO_InitStruct.Speed = GPIO_SPEED_FREQ_LOW;
  HAL_GPIO_Init(GPIOB, &GPIO_InitStruct);

  /*Configure GPIO pin : VBUS_SENSE_Pin */
  GPIO_InitStruct.Pin = VBUS_SENSE_Pin;
  GPIO_InitStruct.Mode = GPIO_MODE_INPUT;
  GPIO_InitStruct.Pull = GPIO_NOPULL;
  HAL_GPIO_Init(VBUS_SENSE_GPIO_Port, &GPIO_InitStruct);

  /*Configure GPIO pin : PA10 */
  GPIO_InitStruct.Pin = GPIO_PIN_10;
  GPIO_InitStruct.Mode = GPIO_MODE_OUTPUT_PP;
  GPIO_InitStruct.Pull = GPIO_NOPULL;
  GPIO_InitStruct.Speed = GPIO_SPEED_FREQ_LOW;
  HAL_GPIO_Init(GPIOA, &GPIO_InitStruct);

  /* USER CODE BEGIN MX_GPIO_Init_2 */

  /* USER CODE END MX_GPIO_Init_2 */
}

/* USER CODE BEGIN 4 */

/* USER CODE END 4 */

/* USER CODE BEGIN Header_StartJackAudioTask */
/**
* @brief Function implementing the JackAudioTask thread.
* @param argument: Not used
* @retval None
*/
/* USER CODE END Header_StartJackAudioTask */
void StartJackAudioTask(void *argument)
{
  /* USER CODE BEGIN 5 */
  /* TEAM CODE (integration: Brendon): run Jack's JackAudioTask */
  /* JackAudioTask (High, 768-word stack): owns I2S2 and its DMA (the PDM
   * microphone). It starts or stops the DMA when JackStorageTask asks
   * (JACK_AUDIO_CMD_FLAG); on each HALF / FULL flag it turns that half into
   * 32 PCM samples and puts them on pcmFrameQueue (timeout 0).
   * This and the four Start*Task functions below share one shape: CubeMX
   * generates the empty task function, and its body only calls the member's
   * X_TaskEntry, which never returns. */
  JackAudio_TaskEntry(argument);   /* never returns */
  /* USER CODE END 5 */
}

/* USER CODE BEGIN Header_StartTomTask */
/**
* @brief Function implementing the TomTask thread.
* @param argument: Not used
* @retval None
*/
/* USER CODE END Header_StartTomTask */
void StartTomTask(void *argument)
{
  /* USER CODE BEGIN StartTomTask */
  /* TEAM CODE (integration: Brendon): run Tom's TomTask */
  /* TomTask (AboveNormal, 1024 words): owns I2S3 and its DMA (the speakers).
   * On each HALF / FULL flag it refills that 4 ms half: playback blocks from
   * audioBlockQueue (32 kHz upsampled, or 48 kHz), a tune or a test pattern,
   * then volume and the speaker crossover. Commands arrive on tomCmdQueue
   * with TOM_CMD_FLAG. */
  Tom_TaskEntry(argument);   /* never returns */
  /* USER CODE END StartTomTask */
}

/* USER CODE BEGIN Header_StartJackStorageTask */
/**
* @brief Function implementing the JackStorageTask thread.
* @param argument: Not used
* @retval None
*/
/* USER CODE END Header_StartJackStorageTask */
void StartJackStorageTask(void *argument)
{
  /* USER CODE BEGIN StartJackStorageTask */
  /* TEAM CODE (integration: Brendon): run Jack's JackStorageTask */
  /* JackStorageTask (Normal, 1024 words): the only task that touches the SD
   * card (SDIO + FatFs). It records pcmFrameQueue into RECnn.WAV files, plays
   * a WAV as AudioBlock_t pointers on audioBlockQueue, answers list and status
   * requests, deletes files, has FxRenderTask make the effect files and hands
   * the card to USB when asked. Commands arrive on jackCmdQueue. */
  JackStorage_TaskEntry(argument);   /* never returns */
  /* USER CODE END StartJackStorageTask */
}

/* USER CODE BEGIN Header_StartBrendonTask */
/**
* @brief Function implementing the BrendonTask thread.
* @param argument: Not used
* @retval None
*/
/* USER CODE END Header_StartBrendonTask */
void StartBrendonTask(void *argument)
{
  /* USER CODE BEGIN StartBrendonTask */
  /* TEAM CODE (integration: Brendon): run Brendon's BrendonTask */
  /* BrendonTask (BelowNormal, 768 words): owns I2C1 (the fuel gauge), the
   * charger pins and the USB device. It publishes the battery once a second
   * on batteryQueue, answers the debug screen's commands on brendonCmdQueue
   * and starts USB only while VBUS is present. */
  Brendon_TaskEntry(argument);   /* never returns */
  /* USER CODE END StartBrendonTask */
}

/* USER CODE BEGIN Header_StartTonyTask */
/**
* @brief Function implementing the TonyTask thread.
* @param argument: Not used
* @retval None
*/
/* USER CODE END Header_StartTonyTask */
void StartTonyTask(void *argument)
{
  /* USER CODE BEGIN StartTonyTask */
  /* TEAM CODE (integration: Brendon): run Tony's TonyTask */
  /* TonyTask (Low, 768 words): owns SPI1 (the TFT screen), ADC1 (touch), the
   * rotary encoder (TIM3) and the buttons. It scans the inputs every 10 ms,
   * sends commands to Jack and Tom, and draws the screens from the status
   * messages it receives. */
  Tony_TaskEntry(argument);   /* never returns */
  /* USER CODE END StartTonyTask */
}

/**
  * @brief  Period elapsed callback in non blocking mode
  * @note   This function is called  when TIM5 interrupt took place, inside
  * HAL_TIM_IRQHandler(). It makes a direct call to HAL_IncTick() to increment
  * a global variable "uwTick" used as application time base.
  * @param  htim : TIM handle
  * @retval None
  */
void HAL_TIM_PeriodElapsedCallback(TIM_HandleTypeDef *htim)
{
  /* USER CODE BEGIN Callback 0 */

  /* USER CODE END Callback 0 */
  if (htim->Instance == TIM5)
  {
    HAL_IncTick();
  }
  /* USER CODE BEGIN Callback 1 */

  /* USER CODE END Callback 1 */
}

/**
  * @brief  This function is executed in case of error occurrence.
  * @retval None
  */
void Error_Handler(void)
{
  /* USER CODE BEGIN Error_Handler_Debug */
  /* User can add his own implementation to report the HAL error return state */
  __disable_irq();
  while (1)
  {
  }
  /* USER CODE END Error_Handler_Debug */
}
#ifdef USE_FULL_ASSERT
/**
  * @brief  Reports the name of the source file and the source line number
  *         where the assert_param error has occurred.
  * @param  file: pointer to the source file name
  * @param  line: assert_param error line source number
  * @retval None
  */
void assert_failed(uint8_t *file, uint32_t line)
{
  /* USER CODE BEGIN 6 */
  /* User can add his own implementation to report the file name and line number,
     ex: printf("Wrong parameters value: file %s on line %d\r\n", file, line) */
  /* USER CODE END 6 */
}
#endif /* USE_FULL_ASSERT */
